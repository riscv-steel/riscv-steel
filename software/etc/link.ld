OUTPUT_ARCH("riscv")
ENTRY(_start)

/* Defines a memory region called RAM where the program must be loaded */
MEMORY { RAM : ORIGIN = 0, LENGTH = 8K }

SECTIONS {

  /* rvsteel.h contains a small boot program defined in a section 
   * named '.boot'. This program must be placed at address 0x00000000,
   * which was defined as the boot address. */
  .boot 0x00000000 : {
    *(.boot)
  } > RAM

  /* Discard non-executable sections generated by RISC-V GCC compiler */
  /DISCARD/ : { *(.comment) *(.riscv.attributes) }

  /* Provide a symbol named '_end' that holds the memory size.
   * This value is used to initialize the stack pointer. */
  _end = LENGTH(RAM);

}